## distro/buildroot/raspberrypi4_defconfig
```kconfig
BR2_aarch64=y
BR2_cortex_a72=y
BR2_TOOLCHAIN_EXTERNAL=y
BR2_INIT_SYSTEMD=y
BR2_ROOTFS_OVERLAY="../../build/rootfs"

# Graphics & Display
BR2_PACKAGE_MESA3D=y
BR2_PACKAGE_MESA3D_GALLIUM_DRIVER_VC4=y
BR2_PACKAGE_WAYLAND=y
BR2_PACKAGE_WAYLAND_PROTOCOLS=y
BR2_PACKAGE_WLROOTS=y
BR2_PACKAGE_LIBINPUT=y
BR2_PACKAGE_SEATD=y

# Audio
BR2_PACKAGE_PIPEWIRE=y
BR2_PACKAGE_ALSA_UTILS=y

# Networking
BR2_PACKAGE_NETWORK_MANAGER=y
BR2_PACKAGE_CURL=y
BR2_PACKAGE_WGET=y
BR2_PACKAGE_DNSMASQ=y
BR2_PACKAGE_DHCP=y

# Web Browser
BR2_PACKAGE_CHROMIUM_BROWSER=y

# Package Management
BR2_PACKAGE_FLATPAK=y

# Python & Development
BR2_PACKAGE_PYTHON3=y
BR2_PACKAGE_PYTHON3_TKINTER=y

# Utilities
BR2_PACKAGE_UTIL_LINUX=y
BR2_PACKAGE_HTOP=y
BR2_PACKAGE_NANO=y

# System Configuration
BR2_TARGET_GENERIC_HOSTNAME="aurora-pi4"
BR2_TARGET_GENERIC_ISSUE="AuroraOS Raspberry Pi 4"
```

## distro/buildroot/x86_64_chromium_defconfig
```kconfig
BR2_x86_64=y
BR2_x86_core2=y
BR2_TOOLCHAIN_EXTERNAL=y
BR2_INIT_SYSTEMD=y
BR2_ROOTFS_OVERLAY="../../build/rootfs"

# Kernel and boot image
BR2_LINUX_KERNEL=y
BR2_LINUX_KERNEL_LATEST_VERSION=y
BR2_LINUX_KERNEL_USE_ARCH_DEFAULT_CONFIG=y
BR2_TARGET_ROOTFS_EXT2=y
BR2_TARGET_ROOTFS_EXT2_4=y
BR2_TARGET_ROOTFS_EXT2_SIZE="8192M"

# AuroraOS 98 graphical base
BR2_PACKAGE_DBUS=y
BR2_PACKAGE_ELOGIND=y
BR2_PACKAGE_LIBDRM=y
BR2_PACKAGE_LIBINPUT=y
BR2_PACKAGE_SEATD=y
BR2_PACKAGE_UDEV=y
BR2_PACKAGE_WAYLAND=y
BR2_PACKAGE_WAYLAND_PROTOCOLS=y
BR2_PACKAGE_WLROOTS=y
BR2_PACKAGE_XKEYBOARD_CONFIG=y

# GPU and software rendering for QEMU/PCs
BR2_PACKAGE_MESA3D=y
BR2_PACKAGE_MESA3D_GALLIUM_DRIVER_SWRAST=y
BR2_PACKAGE_MESA3D_GALLIUM_DRIVER_VIRGL=y
BR2_PACKAGE_MESA3D_OPENGL_EGL=y
BR2_PACKAGE_MESA3D_OPENGL_ES=y

# Browser runtime dependencies
BR2_PACKAGE_FIREFOX=y
BR2_PACKAGE_CHROMIUM_BROWSER=y
BR2_PACKAGE_FONTCONFIG=y
BR2_PACKAGE_DEJAVU=y
BR2_PACKAGE_HARFBUZZ=y
BR2_PACKAGE_NSS=y
BR2_PACKAGE_LIBGTK3=y

# Audio, network, packages
BR2_PACKAGE_PIPEWIRE=y
BR2_PACKAGE_ALSA_UTILS=y
BR2_PACKAGE_NETWORK_MANAGER=y
BR2_PACKAGE_CURL=y
BR2_PACKAGE_WGET=y
BR2_PACKAGE_FLATPAK=y

# Developer and diagnostic tools
BR2_PACKAGE_BASH=y
BR2_PACKAGE_BUSYBOX_SHOW_OTHERS=y
BR2_PACKAGE_GIT=y
BR2_PACKAGE_HTOP=y
BR2_PACKAGE_NANO=y
BR2_PACKAGE_PYTHON3=y
BR2_PACKAGE_UTIL_LINUX=y

BR2_TARGET_GENERIC_HOSTNAME="auroraos98"
BR2_TARGET_GENERIC_ISSUE="AuroraOS 98 Firefox Chromium QEMU"
```
